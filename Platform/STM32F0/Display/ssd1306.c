//SSD1306 library 
#include "ssd1306.h"
#include <stddef.h>
#include <string.h>

#include "stm32f0xx_hal.h"
#include "i2c.h"

//----------------------------------------------------------------------------------

#define OWN_ADDRESS     0x70
#define LCD_ADDRESS     0x78

//----------------------------------------------------------------------------------
#define DATA_MODE       0x40
#define COMMAND_MODE    0x00   // bit Co = 0, D/C# = 0

#define BUFF_SIZE       513
#define SSD1306_CONTRAST 0x20

#define column_start    0
#define column_end      127
#define page_start      0
#define page_end        3
//----------------------------------------------------------------------------------

/* SSD1306 data format: one control byte followed by four 128-column pages. */
static uint8_t lcd_buff[BUFF_SIZE];
static uint8_t lcd_last_buff[BUFF_SIZE - 1U];
static uint8_t lcd_page_tx[129U];
static uint8_t lcd_frame_valid;
static uint16_t lcd_buff_idx;
static uint8_t x_cur;
static uint8_t y_cur;

static uint8_t comm[]={ 
   0x00, 	         //COMMAND_MODE command
   0xAE,             //Display Off
   0xD5,0x80,
   
   0xA8,0x1F,        //Set Multiplex Ratio     1F - 128x32, 3F - 128x64
   
   0xD3,0x00,        //Set Display Offset
   0x40,
   
   0x8D,0x14,        // Charge Pump set:   0x10 = VCC Supplied Externally  
                      // 0x14 = VCC Generated by Internal
   
   0x20,0x00,        //Set Memory Addressing Mode 
   
   0xA0,             //Set Segment Re-map  A0/A1
   0xC0,             //Vertical flip    C0/C8
   
   0xDA,0x02,        //Set COM Pins Hardware Configuration 
   
   0x81,SSD1306_CONTRAST, // Lower contrast reduces the current of lit OLED pixels.
   
   0xD9,0xF1,        //Set Pre-Charge Period:  0x22 = VCC Supplied Externally
   //0xF1 = VCC Generated by Internal             
   
   0xDB,0x40,        //Set VCOMH Deselect Level
   
   0xA4,             //Set Entire Display On/Off
   0xA6,             //Set NORMAL/INVERT Display   A6/A7
   
   0xAF,             //Display On
   
   0xFF
};
//----------------------------------------------------------------------------------
/* Each printable glyph is five columns wide; LCD_Chr adds a blank sixth column. */
static const uint8_t font [][5] =
{
   { 0x00, 0x00, 0x00, 0x00, 0x00 },   //   0x20  32
   { 0x00, 0x00, 0x5F, 0x00, 0x00 },   // ! 0x21  33
   { 0x00, 0x07, 0x00, 0x07, 0x00 },   // " 0x22  34
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   { 0x06, 0x09, 0x09, 0x06, 0x00 },   // heart 0x7F 127    
};

void LCD_Init(void)
{
   lcd_frame_valid = 0U;
   HAL_I2C_Master_Transmit(&hi2c1, LCD_ADDRESS, comm, sizeof(comm),10);
}
//----------------------------------------------------------------------------------
void  LCD_command(uint8_t cmd)
{   
   uint8_t cmd_arr[2] = {0,0};
   cmd_arr[0] = COMMAND_MODE;
   cmd_arr[1] = cmd;
   HAL_I2C_Master_Transmit(&hi2c1, LCD_ADDRESS, cmd_arr, sizeof(cmd_arr),10);
}
//----------------------------------------------------------------------------------
bool LCD_SetContrast(uint8_t contrast)
{
   uint8_t command[] = { COMMAND_MODE, 0x81U, contrast };
   return HAL_I2C_Master_Transmit(&hi2c1, LCD_ADDRESS, command,
                                  sizeof(command), 10U) == HAL_OK;
}
//----------------------------------------------------------------------------------
void LCD_On(void)
{
   LCD_command(0xAF);
}
//----------------------------------------------------------------------------------
void LCD_Off(void)
{
   LCD_command(0xAE);
}
//----------------------------------------------------------------------------------
void LCD_Clear(void)
{
   for(uint16_t ix = 1; ix < BUFF_SIZE; ix++)
   {
      lcd_buff[ix] = 0;
   }
   x_cur = 0;
   y_cur = 0;
}
//----------------------------------------------------------------------------------
void LCD_Update(void)
{
   lcd_buff[0] = DATA_MODE;

   if (lcd_frame_valid == 0U)
   {
      /* Initialize every OLED page once; later frames send changed spans only. */
      uint8_t window[] = {
         COMMAND_MODE, 0x21, column_start, column_end,
         0x22, page_start, page_end
      };
      if ((HAL_I2C_Master_Transmit(&hi2c1, LCD_ADDRESS, window,
                                   sizeof(window), 10U) == HAL_OK) &&
          (HAL_I2C_Master_Transmit(&hi2c1, LCD_ADDRESS, lcd_buff,
                                   BUFF_SIZE, 50U) == HAL_OK))
      {
         memcpy(lcd_last_buff, &lcd_buff[1], BUFF_SIZE - 1U);
         lcd_frame_valid = 1U;
      }
      return;
   }

   for (uint8_t page = page_start; page <= page_end; ++page)
   {
      const uint16_t page_offset = (uint16_t)page * 128U;
      uint8_t first = 128U;
      uint8_t last = 0U;

      for (uint16_t column = 0U; column < 128U; ++column)
      {
         const uint16_t index = page_offset + column;
         if (lcd_buff[index + 1U] != lcd_last_buff[index])
         {
            if (first == 128U)
            {
               first = (uint8_t)column;
            }
            last = (uint8_t)column;
         }
      }

      if (first != 128U)
      {
         const uint8_t span_length = (uint8_t)(last - first + 1U);
         uint8_t window[] = {
            COMMAND_MODE, 0x21, first, last,
            0x22, page, page
         };

         lcd_page_tx[0] = DATA_MODE;
         memcpy(&lcd_page_tx[1],
                &lcd_buff[page_offset + first + 1U],
                span_length);

         if ((HAL_I2C_Master_Transmit(&hi2c1, LCD_ADDRESS, window,
                                      sizeof(window), 10U) == HAL_OK) &&
             (HAL_I2C_Master_Transmit(&hi2c1, LCD_ADDRESS, lcd_page_tx,
                                      (uint16_t)span_length + 1U,
                                      50U) == HAL_OK))
         {
            memcpy(&lcd_last_buff[page_offset],
                   &lcd_buff[page_offset + 1U],
                   128U);
         }
      }
   }
}
//----------------------------------------------------------------------------------
void LCD_Chr(char ch)
{
   uint8_t i;
   uint8_t glyph;
   lcd_buff_idx=(y_cur*128 + x_cur*6) + 1;    
   if ((ch >= 0x20)&&(ch <= 0x7F)) glyph = (uint8_t)ch - 32U;
   else glyph = 95U;
   for (i = 0; i < 5; i++)
   {
        lcd_buff[lcd_buff_idx++] = font[glyph][i];
   }
   lcd_buff[lcd_buff_idx++] = 0x00;  
   x_cur++;
   if (x_cur > 20)
   {
      x_cur = 0;
      y_cur++;
      if (y_cur > 3)
      {
         y_cur = 0;
      }
   }
}
//----------------------------------------------------------------------------------
void LCD_2xChr(char ch)
{
   uint8_t i, c, glyph;
   uint8_t	b1, b2;  
   uint16_t	tmpIdx;
   
   lcd_buff_idx = (y_cur*128+x_cur*6)+1;
   tmpIdx = lcd_buff_idx-128;
   if ((ch >= 0x20)&&(ch <= 0x7F)) glyph = (uint8_t)ch - 32U;
   else glyph = 95U;
   
   for ( i = 0; i < 5; i++ ){
      c = font[glyph][i];
      b1  = (c&0x01)*3;
      b1 |= (c&0x02)*6;
      b1 |= (c&0x04)*12;
      b1 |= (c&0x08)*24;
      
      c >>= 4;
      b2  = (c&0x01)*3;
      b2 |= (c&0x02)*6;
      b2 |= (c&0x04)*12;
      b2 |= (c&0x08)*24;
      
      lcd_buff[tmpIdx++] = b1;
      lcd_buff[tmpIdx++] = b1;
      lcd_buff[tmpIdx+126] = b2;
      lcd_buff[tmpIdx+127] = b2;
   }
   lcd_buff_idx = (lcd_buff_idx + 11) % BUFF_SIZE;
   lcd_buff[lcd_buff_idx] = 0x00;    
   if(lcd_buff_idx == (BUFF_SIZE-1)) lcd_buff_idx = 1;
   else lcd_buff_idx++;
   x_cur = x_cur + 2;
   if (x_cur > 19){
      x_cur = 0;
      y_cur = y_cur + 2;
      if (y_cur > 3){
         y_cur = 0;
      }
   }
}
//----------------------------------------------------------------------------------
void LCD_FStr(const char *dataPtr, uint8_t x, uint8_t y)
{
   LCD_GotoXY(x,y);
   while(*dataPtr != 0)
   {
      LCD_Chr(*dataPtr);
      dataPtr++;
   }
}
//----------------------------------------------------------------------------------
void LCD_FScrollStr(const char *text,
                    uint8_t pixel_offset,
                    uint8_t page,
                    uint8_t width)
{
   if ((pixel_offset >= 6U) || (page > page_end) || (width > 128U))
   {
      return;
   }

   /* Offset spans six-pixel cells: five glyph columns plus one blank column. */
   const uint16_t page_offset = (uint16_t)page * 128U + 1U;
   for (uint16_t column = 0U; column < width; ++column)
   {
      const uint16_t source_pixel = column + pixel_offset;
      const uint16_t character_index = source_pixel / 6U;
      const uint8_t glyph_column = (uint8_t)(source_pixel % 6U);
      const char character = text[character_index];
      uint8_t pixel_data = 0U;

      if ((character != '\0') && (glyph_column < 5U))
      {
         const uint8_t glyph = ((character >= 0x20) && (character <= 0x7F))
                                   ? (uint8_t)character - 32U
                                   : 95U;
         pixel_data = font[glyph][glyph_column];
      }

      lcd_buff[page_offset + column] = pixel_data;
   }
}
////----------------------------------------------------
void LCD_2xFStr(const char *dataPtr, uint8_t x, uint8_t y)
{
   LCD_GotoXY(x,y);
   while(*dataPtr!=0)
   {
      LCD_2xChr(*dataPtr);
      dataPtr++;
   }
}
////----------------------------------------------------
void LCD_GotoXY(uint8_t x,uint8_t y)
{
   if((x < 21)&&(y < (page_end+1)))
   {
      x_cur = x;
      y_cur = y;
   }
}
////----------------------------------------------------
////  This function adds a battery symbol to the lcd buffer
////----------------------------------------------------
void LCD_Batt(int val, uint8_t x, uint8_t y)
{   
   uint8_t bat_arr[] = { 0x1C, 0x1C, 0x7F, 0x41, 0x41, 0x41, 0x41, 
                    0x41, 0x41, 0x41, 0x41, 0x41, 0x41, 0x41, 
                    0x41, 0x41, 0x41, 0x41, 0x7F 
                  };
   const uint8_t battery_width = (uint8_t)sizeof(bat_arr);
   if ((x > 128U) || (x < battery_width) || (y > page_end))
   {
       return;
   }
   if (val < 3218) val = 3218;
   if (val > 4096) val = 4096;
   uint8_t fill_count = (uint8_t)(((val - 3218) * (battery_width - 3U)) / (4096 - 3218));
   for (uint8_t i = 0; i < fill_count; ++i)
   {
      bat_arr[battery_width - 1U - i] = 0x7F;
   }
   lcd_buff_idx = (uint16_t)(1U + (uint16_t)y * 128U + x - battery_width);
   for(uint8_t i = 0; i < battery_width; i++)
   {
      lcd_buff[lcd_buff_idx++]=bat_arr[i];
   }
}

static void lcd_set_pixel(uint8_t x, uint8_t y)
{
   const uint16_t index = (uint16_t)(1U + (uint16_t)(y / 8U) * 128U + x);
   lcd_buff[index] |= (uint8_t)(1U << (y % 8U));
}

/* Draw a row-major monochrome bitmap; zero bits leave the framebuffer unchanged. */
void LCD_DrawBitmap(const uint8_t *bitmap,
                    uint8_t width,
                    uint8_t height,
                    uint8_t row_stride,
                    int16_t x,
                    int16_t y)
{
   const uint16_t minimum_stride = (uint16_t)(((uint16_t)width + 7U) / 8U);

   if ((bitmap == NULL) || (width == 0U) || (height == 0U) ||
       (row_stride < minimum_stride))
   {
      return;
   }

   for (uint16_t source_y = 0U; source_y < height; ++source_y)
   {
      for (uint16_t source_x = 0U; source_x < width; ++source_x)
      {
         const uint16_t bitmap_index =
             (uint16_t)(source_y * row_stride + source_x / 8U);
         const uint8_t bitmap_mask = (uint8_t)(0x80U >> (source_x % 8U));

         if ((bitmap[bitmap_index] & bitmap_mask) != 0U)
         {
            const int32_t pixel_x = (int32_t)x + source_x;
            const int32_t pixel_y = (int32_t)y + source_y;

            if ((pixel_x >= 0) && (pixel_x < 128) &&
                (pixel_y >= 0) && (pixel_y < 32))
            {
               lcd_set_pixel((uint8_t)pixel_x, (uint8_t)pixel_y);
            }
         }
      }
   }
}

static void lcd_draw_line(int16_t x0, int16_t y0, int16_t x1, int16_t y1)
{
   const int16_t dx = (x1 >= x0) ? (x1 - x0) : (x0 - x1);
   const int16_t dy = (int16_t)-((y1 >= y0) ? (y1 - y0) : (y0 - y1));
   const int16_t step_x = (x0 < x1) ? 1 : -1;
   const int16_t step_y = (y0 < y1) ? 1 : -1;
   int16_t error = (int16_t)(dx + dy);

   for (;;) {
      if ((x0 >= 0) && (x0 < 128) && (y0 >= 0) && (y0 < 32)) {
         lcd_set_pixel((uint8_t)x0, (uint8_t)y0);
      }
      if ((x0 == x1) && (y0 == y1)) {
         break;
      }

      const int16_t doubled_error = (int16_t)(2 * error);
      if (doubled_error >= dy) {
         error = (int16_t)(error + dy);
         x0 = (int16_t)(x0 + step_x);
      }
      if (doubled_error <= dx) {
         error = (int16_t)(error + dx);
         y0 = (int16_t)(y0 + step_y);
      }
   }
}

static const int8_t lcd_sine_q7[64] = {
   0, 12, 25, 37, 49, 60, 71, 81, 90, 98, 106, 112, 117, 122, 125, 127,
   127, 127, 125, 122, 117, 112, 106, 98, 90, 81, 71, 60, 49, 37, 25, 12,
   0, -12, -25, -37, -49, -60, -71, -81, -90, -98, -106, -112, -117, -122,
   -125, -127, -127, -127, -125, -122, -117, -112, -106, -98, -90, -81,
   -71, -60, -49, -37, -25, -12
};

static int16_t lcd_q7_sum(int16_t a, int16_t factor_a,
                          int16_t b, int16_t factor_b)
{
   int32_t product = (int32_t)a * factor_a + (int32_t)b * factor_b;
   product += (product >= 0) ? 64 : -64;
   return (int16_t)(product / 128);
}

void LCD_DrawOctahedron(uint8_t angle, uint8_t center_x, uint8_t center_y)
{
   static const int8_t vertices[6][3] = {
      { 10,  0,  0}, {-10,  0,  0},
      {  0, 10,  0}, {  0,-10,  0},
      {  0,  0, 10}, {  0,  0,-10}
   };
   static const uint8_t edges[12][2] = {
      {0U, 2U}, {0U, 3U}, {0U, 4U}, {0U, 5U},
      {1U, 2U}, {1U, 3U}, {1U, 4U}, {1U, 5U},
      {2U, 4U}, {2U, 5U}, {3U, 4U}, {3U, 5U}
   };
   int16_t projected_x[6];
   int16_t projected_y[6];
   const uint8_t rotation_x = (uint8_t)((angle / 2U + 8U) & 63U);
   const int16_t sin_y = lcd_sine_q7[angle & 63U];
   const int16_t cos_y = lcd_sine_q7[(angle + 16U) & 63U];
   const int16_t sin_x = lcd_sine_q7[rotation_x];
   const int16_t cos_x = lcd_sine_q7[(rotation_x + 16U) & 63U];

   for (uint8_t vertex = 0U; vertex < 6U; ++vertex) {
      const int16_t x = vertices[vertex][0];
      const int16_t y = vertices[vertex][1];
      const int16_t z = vertices[vertex][2];
      const int16_t rotated_x = lcd_q7_sum(x, cos_y, z, sin_y);
      const int16_t rotated_z = lcd_q7_sum((int16_t)-x, sin_y, z, cos_y);
      const int16_t rotated_y = lcd_q7_sum(y, cos_x,
                                           (int16_t)-rotated_z, sin_x);

      projected_x[vertex] = (int16_t)(center_x + rotated_x);
      projected_y[vertex] = (int16_t)(center_y + rotated_y);
   }

   for (uint8_t edge = 0U; edge < 12U; ++edge) {
      const uint8_t first = edges[edge][0];
      const uint8_t second = edges[edge][1];
      lcd_draw_line(projected_x[first], projected_y[first],
                    projected_x[second], projected_y[second]);
   }
}

void LCD_DrawCube(uint8_t angle, uint8_t center_x, uint8_t center_y)
{
   static const int8_t vertices[8][3] = {
      {-4, -4, -4}, { 4, -4, -4}, { 4,  4, -4}, {-4,  4, -4},
      {-4, -4,  4}, { 4, -4,  4}, { 4,  4,  4}, {-4,  4,  4}
   };
   static const uint8_t edges[12][2] = {
      {0U, 1U}, {1U, 2U}, {2U, 3U}, {3U, 0U},
      {4U, 5U}, {5U, 6U}, {6U, 7U}, {7U, 4U},
      {0U, 4U}, {1U, 5U}, {2U, 6U}, {3U, 7U}
   };
   int16_t projected_x[8];
   int16_t projected_y[8];
   const uint8_t rotation_x = (uint8_t)((angle / 2U + 8U) & 63U);
   const int16_t sin_y = lcd_sine_q7[angle & 63U];
   const int16_t cos_y = lcd_sine_q7[(angle + 16U) & 63U];
   const int16_t sin_x = lcd_sine_q7[rotation_x];
   const int16_t cos_x = lcd_sine_q7[(rotation_x + 16U) & 63U];

   for (uint8_t vertex = 0U; vertex < 8U; ++vertex) {
      const int16_t x = vertices[vertex][0];
      const int16_t y = vertices[vertex][1];
      const int16_t z = vertices[vertex][2];
      const int16_t rotated_x = lcd_q7_sum(x, cos_y, z, sin_y);
      const int16_t rotated_z = lcd_q7_sum((int16_t)-x, sin_y, z, cos_y);
      const int16_t rotated_y = lcd_q7_sum(y, cos_x,
                                           (int16_t)-rotated_z, sin_x);

      projected_x[vertex] = (int16_t)(center_x + rotated_x);
      projected_y[vertex] = (int16_t)(center_y + rotated_y);
   }

   for (uint8_t edge = 0U; edge < 12U; ++edge) {
      const uint8_t first = edges[edge][0];
      const uint8_t second = edges[edge][1];
      lcd_draw_line(projected_x[first], projected_y[first],
                    projected_x[second], projected_y[second]);
   }
}

void LCD_DrawCross(uint8_t angle, uint8_t center_x, uint8_t center_y)
{
   const int16_t sin_angle = lcd_sine_q7[angle & 63U];
   const int16_t cos_angle = lcd_sine_q7[(angle + 16U) & 63U];
   const int16_t dx = lcd_q7_sum(4, cos_angle, 0, 0);
   const int16_t dy = lcd_q7_sum(4, sin_angle, 0, 0);

   lcd_draw_line((int16_t)(center_x - dx), (int16_t)(center_y - dy),
                 (int16_t)(center_x + dx), (int16_t)(center_y + dy));
   lcd_draw_line((int16_t)(center_x - dy), (int16_t)(center_y + dx),
                 (int16_t)(center_x + dy), (int16_t)(center_y - dx));
}

void LCD_Thermometer(int16_t celsius, bool valid, uint8_t x, uint8_t y)
{
   static const uint8_t outline[32] = {
      0x18U, 0x24U, 0x24U, 0x24U, 0x24U, 0x24U, 0x24U, 0x24U,
      0x24U, 0x24U, 0x24U, 0x24U, 0x24U, 0x24U, 0x24U, 0x24U,
      0x24U, 0x24U, 0x24U, 0x24U, 0x24U, 0x24U, 0x24U, 0x66U,
      0x42U, 0x81U, 0x81U, 0x81U, 0x81U, 0x81U, 0x42U, 0x3CU
   };

   if ((x > 120U) || (y > 0U))
   {
      return;
   }

   for (uint8_t row = 0U; row < 32U; ++row)
   {
      for (uint8_t column = 0U; column < 8U; ++column)
      {
         if ((outline[row] & (uint8_t)(1U << column)) != 0U)
         {
            lcd_set_pixel((uint8_t)(x + column), (uint8_t)(y + row));
         }
      }
   }

   if (!valid)
   {
      return;
   }

   if (celsius < -20)
   {
      celsius = -20;
   }
   else if (celsius > 80)
   {
      celsius = 80;
   }

   const uint8_t stem_fill = (uint8_t)(((int32_t)celsius + 20) * 20 / 100);
   /* Keep the bulb filled and raise the stem level with measured temperature. */
   lcd_set_pixel((uint8_t)(x + 3U), (uint8_t)(y + 24U));
   lcd_set_pixel((uint8_t)(x + 4U), (uint8_t)(y + 24U));
   for (uint8_t row = 25U; row <= 29U; ++row)
   {
      for (uint8_t column = 2U; column <= 5U; ++column)
      {
         lcd_set_pixel((uint8_t)(x + column), (uint8_t)(y + row));
      }
   }
   lcd_set_pixel((uint8_t)(x + 3U), (uint8_t)(y + 30U));
   lcd_set_pixel((uint8_t)(x + 4U), (uint8_t)(y + 30U));

   for (uint8_t level = 0U; level < stem_fill; ++level)
   {
      const uint8_t row = (uint8_t)(22U - level);
      lcd_set_pixel((uint8_t)(x + 3U), (uint8_t)(y + row));
      lcd_set_pixel((uint8_t)(x + 4U), (uint8_t)(y + row));
   }
}
////-----------------------------------------------------------------------


