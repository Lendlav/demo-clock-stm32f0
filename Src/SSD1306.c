//SSD1306 library 
#include "SSD1306.h"
#include "stm32f0xx_hal.h"

//----------------------------------------------------------------------------------

#define OWN_ADDRESS     0x70
#define LCD_ADDRESS     0x78

//----------------------------------------------------------------------------------
#define DATA_MODE       0x40
#define COMMAND_MODE    0x00   // bit Co = 0, D/C# = 0

#define BUFF_SIZE       513

#define column_start    0
#define column_end      127
#define page_start      0
#define page_end        3
//----------------------------------------------------------------------------------

//----------------------------------------------------------------------------------
extern I2C_HandleTypeDef hi2c1;

uint8_t  lcd_buff[BUFF_SIZE];
uint16_t lcd_buff_idx=0;
uint8_t  x_cur=0;
uint8_t  y_cur=0;

uint8_t comm[]={ 
   0x00, 	         //COMMAND_MODE command
   0xAE,             //Display Off
   0xD5,0x80,
   
   0xA8,0x1F,        //Set Multiplex Ratio     1F - 128x32, 3F - 128x64
   
   0xD3,0x00,        //Set Display Offset
   0x40,
   
   0x8D,0x14,        // Charge Pump set:   0x10 = VCC Supplied Externally  
                      // 0x14 = VCC Generated by Internal
   
   0x20,0x00,        //Set Memory Addressing Mode 
   
   0xA0,             //Set Segment Re-map  A0/A1
   0xC0,             //Vertical flip    C0/C8
   
   0xDA,0x02,        //Set COM Pins Hardware Configuration 
   
   0x81,0xA2,        //Set Contrast Control 
   
   0xD9,0xF1,        //Set Pre-Charge Period:  0x22 = VCC Supplied Externally  \
   //0xF1 = VCC Generated by Internal             
   
   0xDB,0x40,        //Set VCOMH Deselect Level
   
   0xA4,             //Set Entire Display On/Off
   0xA6,             //Set NORMAL/INVERT Display   A6/A7
   
   0xAF,             //Display On
   
   0xFF
};
//----------------------------------------------------------------------------------
void LCD_Init(void)
{
   HAL_I2C_Master_Transmit(&hi2c1, LCD_ADDRESS, comm, sizeof(comm),10);
}
//----------------------------------------------------------------------------------
void  LCD_command(uint8_t cmd)
{   
   uint8_t cmd_arr[2] = {0,0};
   cmd_arr[0] = COMMAND_MODE;
   cmd_arr[1] = cmd;
   HAL_I2C_Master_Transmit(&hi2c1, LCD_ADDRESS, cmd_arr, sizeof(cmd_arr),10);
}
//----------------------------------------------------------------------------------
void LCD_On(void)
{
   LCD_command(0xAF);
}
//----------------------------------------------------------------------------------
void LCD_Off(void)
{
   LCD_command(0xAE);
}
//----------------------------------------------------------------------------------
void LCD_Clear(void)
{
   for(uint16_t ix = 1; ix < BUFF_SIZE; ix++)
   {
      lcd_buff[ix] = 0;
   }
   x_cur = 0;
   y_cur = 0;
}
//----------------------------------------------------------------------------------
void LCD_Update(void)
{
   LCD_command(0x21);		      // SSD1306_COLUMNADDR
   LCD_command(column_start);     // column start
   LCD_command(column_end);       // column end
   LCD_command(0x22);             // SSD1306_PAGEADDR
   LCD_command(page_start);       // page start
   LCD_command(page_end);         // page end (4 pages for 32 rows OLED)
   
   lcd_buff[0]= DATA_MODE;              
   
   HAL_I2C_Master_Transmit(&hi2c1, LCD_ADDRESS, lcd_buff, BUFF_SIZE,50);
}
//----------------------------------------------------------------------------------
void LCD_Chr(char ch)
{
   uint8_t i;   
   lcd_buff_idx=(y_cur*128 + x_cur*6) + 1;    
   if ((ch >= 0x20)&&(ch <= 0x7F)) ch -= 32;
   else ch = 95;   
   for (i = 0; i < 5; i++)
   {
        lcd_buff[lcd_buff_idx++] = font[ch][i];       
   }
   lcd_buff[lcd_buff_idx++] = 0x00;  
   x_cur++;
   if (x_cur > 20)
   {
      x_cur = 0;
      y_cur++;
      if (y_cur > 3)
      {
         y_cur = 0;
      }
   }
}
//----------------------------------------------------------------------------------
void LCD_2xChr(char ch)
{
   uint8_t	i, c;
   uint8_t	b1, b2;  
   uint16_t	tmpIdx;
   
   lcd_buff_idx = (y_cur*128+x_cur*6)+1;
   tmpIdx = lcd_buff_idx-128;
   if ((ch >= 0x20)&&(ch <= 0x7F)) ch -= 32;
   else ch = 95;
   
   for ( i = 0; i < 5; i++ ){
      c = font[ch][i]; 
      b1  = (c&0x01)*3;
      b1 |= (c&0x02)*6;
      b1 |= (c&0x04)*12;
      b1 |= (c&0x08)*24;
      
      c >>= 4;
      b2  = (c&0x01)*3;
      b2 |= (c&0x02)*6;
      b2 |= (c&0x04)*12;
      b2 |= (c&0x08)*24;
      
      lcd_buff[tmpIdx++] = b1;
      lcd_buff[tmpIdx++] = b1;
      lcd_buff[tmpIdx+126] = b2;
      lcd_buff[tmpIdx+127] = b2;
   }
   lcd_buff_idx = (lcd_buff_idx + 11) % BUFF_SIZE;
   lcd_buff[lcd_buff_idx] = 0x00;    
   if(lcd_buff_idx == (BUFF_SIZE-1)) lcd_buff_idx = 1;
   else lcd_buff_idx++;
   x_cur = x_cur + 2;
   if (x_cur > 19){
      x_cur = 0;
      y_cur = y_cur + 2;
      if (y_cur > 3){
         y_cur = 0;
      }
   }
}
//----------------------------------------------------------------------------------
void LCD_FStr(const char *dataPtr, uint8_t x, uint8_t y)
{
   LCD_GotoXY(x,y);
   while(*dataPtr != 0)
   {
      LCD_Chr(*dataPtr);
      dataPtr++;
   }
}
////----------------------------------------------------
void LCD_2xFStr(const char *dataPtr, uint8_t x, uint8_t y)
{
   LCD_GotoXY(x,y);
   while(*dataPtr!=0)
   {
      LCD_2xChr(*dataPtr);
      dataPtr++;
   }
}
////----------------------------------------------------
void LCD_GotoXY(uint8_t x,uint8_t y)
{
   if((x < 21)&&(y < (page_end+1)))
   {
      x_cur = x;
      y_cur = y;
   }
}
////----------------------------------------------------
////  This function adds a battery symbol to the lcd buffer
////----------------------------------------------------
void LCD_Batt(int val, uint8_t x, uint8_t y)
{   
   uint8_t bat_arr[] = { 0x1C, 0x1C, 0x7F, 0x41, 0x41, 0x41, 0x41, 
                    0x41, 0x41, 0x41, 0x41, 0x41, 0x41, 0x41, 
                    0x41, 0x41, 0x41, 0x41, 0x7F 
                  };
   if(x == 0) 
   {
       x = sizeof(bat_arr);
   }
   uint8_t cnt_val = sizeof(bat_arr);
   val -=3218;
   while(val > 0)
   {      
      bat_arr[cnt_val--]= 0x7F;
      val -=((4096-3218)/(sizeof(bat_arr)-3));  // array
   }
   lcd_buff_idx = (y*128 + x-18);
   for(uint8_t i = 0; i<sizeof(bat_arr); i++)
   {
      lcd_buff[lcd_buff_idx++]=bat_arr[i];
   }
}
////-----------------------------------------------------------------------
const uint8_t font [][5] = 
{
   { 0x00, 0x00, 0x00, 0x00, 0x00 },   //   0x20  32
   { 0x00, 0x00, 0x5F, 0x00, 0x00 },   // ! 0x21  33
   { 0x00, 0x07, 0x00, 0x07, 0x00 },   // " 0x22  34
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   { 0x06, 0x09, 0x09, 0x06, 0x00 },   // heart 0x7F 127    
};





